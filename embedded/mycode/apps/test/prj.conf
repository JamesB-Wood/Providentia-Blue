## CMakeLists.txt
```
# SPDX-License-Identifier: Apache-2.0

cmake_minimum_required(VERSION 3.20.0)

find_package(Zephyr REQUIRED HINTS $ENV{ZEPHYR_BASE})
project(prac1)

file(GLOB MYLIB ../../mylib/*.c)

include_directories(../../include/)

target_sources(app PRIVATE src/main.c ${MYLIB})
```

## prj.conf
```kconfig
CONFIG_HEAP_MEM_POOL_SIZE=256

CONFIG_SERIAL=y
CONFIG_UART_INTERRUPT_DRIVEN=y

CONFIG_JSON_LIBRARY=y
CONFIG_CBPRINTF_FP_SUPPORT=y
```

## src/main.c
```c
#include "json_uart.h"
#include <zephyr/kernel.h>


int main(){
    sensor_data_t data;
    data.tvoc = 1000;
    data.co2 = 2000;
    data.humidity = 505;
    data.temp = 165;
    int data_values[64] = {100,100,100,100,100,100,100,100,100,100,100,100,100,100,100,100,100,100,100,100,100,100,100,100,100,100,100,100,100,100,100,100,100,100,100,100,100,100,100,100,100,100,100,100,100,100,100,100,100,100,100,100,100,100,100,100,100,100,100,100,100,100,100,100};
    memcpy(data.ir_grid.ir_grid_data, data_values, sizeof(data_values));
    send_sensor_data(data);
}
```
